/ {
    chosen {
        zmk,underglow = &led_strip;
    };
};

&led_strip {
    compatible = "worldsemi,ws2812-spi";
    chain-length = <12>;  // Adjust based on your number of LEDs
    spi-max-frequency = <8000000>;
};
