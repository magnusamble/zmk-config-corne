/ {
    chosen {
        zmk,underglow = &ws2812_leds;
    };
};

&spi1 {
    status = "okay";
    
    ws2812_leds: led_strip {
        compatible = "worldsemi,ws2812-spi";
        chain-length = <27>;
        spi-max-frequency = <8000000>;
    };
};
